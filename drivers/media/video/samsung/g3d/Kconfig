## drivers/media/video/samsung/g3d/Kconfig
```kconfig
# drivers/media/video/samsung/g3d/Kconfig
#
# Copyright (c) 2010 Samsung Electronics Co., Ltd.
# 		http://www.samsung.com/
#
# Licensed under GPLv2

config VIDEO_G3D
	bool "Samsung 540 3D Driver"
	depends on VIDEO_SAMSUNG && (CPU_S5PV210)
	default n
	help
	  This is a graphics 3D (540) driver for Samsung S5PV210.
```
